## boards/shields/sp_10key/Kconfig.defconfig
```kconfig
if SHIELD_SP_10KEY_LEFT

config ZMK_KEYBOARD_NAME
    default "sp_10key"

endif

if SHIELD_SP_10KEY_LEFT || SHIELD_SP_10KEY_RIGHT

config ZMK_SPLIT
    default y

endif
```

## boards/shields/sp_10key/Kconfig.shield
```kconfig
config SHIELD_SP_10KEY_LEFT
    def_bool $(shields_list_contains,sp_10key_left)
config SHIELD_SP_10KEY_RIGHT
    def_bool $(shields_list_contains,sp_10key_right)
```
